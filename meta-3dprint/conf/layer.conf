## meta-3dprint/conf/layer.conf
```bitbake
# We have a conf and classes directory, add to BBPATH
BBPATH .= ":${LAYERDIR}"

# We have recipes-* directories, add to BBFILES
BBFILES += "${LAYERDIR}/recipes-*/*/*.bb \
            ${LAYERDIR}/recipes-*/*/*.bbappend"

BBFILE_COLLECTIONS += "meta-3dprint"
BBFILE_PATTERN_meta-3dprint = "^${LAYERDIR}/"
BBFILE_PRIORITY_meta-3dprint = "6"

LAYERDEPENDS_meta-3dprint = "core"
LAYERSERIES_COMPAT_meta-3dprint = "nanbield"
```
